## SmartSocket_Test/main/Kconfig.projbuild
```kconfig
menu "SSD1306 Configuration"

	config GPIO_RANGE_MAX
		int
		default 33 if IDF_TARGET_ESP32
		default 46 if IDF_TARGET_ESP32S2
		default 48 if IDF_TARGET_ESP32S3
		default 18 if IDF_TARGET_ESP32C2
		default 19 if IDF_TARGET_ESP32C3
		default 30 if IDF_TARGET_ESP32C6
		default 27 if IDF_TARGET_ESP32H2

	choice INTERFACE
		prompt "Interface"
		default I2C_INTERFACE
		help
			Select Interface.
		config I2C_INTERFACE
			bool "I2C Interface"
			help
				I2C Interface.
		config SPI_INTERFACE
			bool "SPI Interface"
			help
				SPI Interface.
	endchoice

	choice PANEL
		prompt "Panel Type"
		default SSD1306_128x64
		help
			Select Panel Type.
		config SSD1306_128x32
			bool "128x32 Panel"
			help
				Panel is 128x32.
		config SSD1306_128x64
			bool "128x64 Panel"
			help
				Panel is 128x64.
	endchoice

	config OFFSETX
		int "GRAM X OFFSET"
		range 0 99
		default 0
		help
			When your TFT have offset(X), set it.

	config FLIP
		bool "Flip upside down"
		default false
		help
			Flip upside down.

	config SCL_GPIO
		depends on I2C_INTERFACE
		int "SCL GPIO number"
		range 0 GPIO_RANGE_MAX
		default 22 if IDF_TARGET_ESP32
		default  2 if IDF_TARGET_ESP32S2 || IDF_TARGET_ESP32S3
		default  2 if IDF_TARGET_ESP32H2
		default  6 # C3 and others
		help
			GPIO number (IOxx) to I2C SCL.
			Some GPIOs are used for other purposes (flash connections, etc.) and cannot be used to I2C.
			GPIOs 35-39 are input-only so cannot be used as outputs.

	config SDA_GPIO
		depends on I2C_INTERFACE
		int "SDA GPIO number"
		range 0 GPIO_RANGE_MAX
		default 21 if IDF_TARGET_ESP32
		default  1 if IDF_TARGET_ESP32S2 || IDF_TARGET_ESP32S3
		default  1 if IDF_TARGET_ESP32H2
		default  5 # C3 and others
		help
			GPIO number (IOxx) to I2C SDA.
			Some GPIOs are used for other purposes (flash connections, etc.) and cannot be used to I2C.
			GPIOs 35-39 are input-only so cannot be used as outputs.

	config MOSI_GPIO
		depends on SPI_INTERFACE
		int "MOSI GPIO number"
		range 0 GPIO_RANGE_MAX
		default 23 if IDF_TARGET_ESP32
		default 35 if IDF_TARGET_ESP32S2 || IDF_TARGET_ESP32S3
		default  1 # C3 and others
		help
			GPIO number (IOxx) to SPI MOSI.
			Some GPIOs are used for other purposes (flash connections, etc.) and cannot be used to MOSI.
			On the ESP32, GPIOs 35-39 are input-only so cannot be used as outputs.
			On the ESP32-S2, GPIO 46 is input-only so cannot be used as outputs.

	config SCLK_GPIO
		depends on SPI_INTERFACE
		int "SCLK GPIO number"
		range 0 GPIO_RANGE_MAX
		default 18 if IDF_TARGET_ESP32
		default 36 if IDF_TARGET_ESP32S2 || IDF_TARGET_ESP32S3
		default  2 # C3 and others
		help
			GPIO number (IOxx) to SPI SCLK.
			Some GPIOs are used for other purposes (flash connections, etc.) and cannot be used to SCLK.
			On the ESP32, GPIOs 35-39 are input-only so cannot be used as outputs.
			On the ESP32-S2, GPIO 46 is input-only so cannot be used as outputs.

	config CS_GPIO
		depends on SPI_INTERFACE
		int "CS GPIO number"
		range 0 GPIO_RANGE_MAX
		default  5 if IDF_TARGET_ESP32
		default 34 if IDF_TARGET_ESP32S2 || IDF_TARGET_ESP32S3
		default 10 # C3 and others
		help
			GPIO number (IOxx) to SPI CS.
			Some GPIOs are used for other purposes (flash connections, etc.) and cannot be used to CS.
			GPIOs 35-39 are input-only so cannot be used as outputs.

	config DC_GPIO
		depends on SPI_INTERFACE
		int "DC GPIO number"
		range 0 GPIO_RANGE_MAX
		default  4 if IDF_TARGET_ESP32
		default 37 if IDF_TARGET_ESP32S2 || IDF_TARGET_ESP32S3
		default  3 # C3 and others
		help
			GPIO number (IOxx) to SPI DC.
			Some GPIOs are used for other purposes (flash connections, etc.) and cannot be used to DC.
			GPIOs 35-39 are input-only so cannot be used as outputs.

	config RESET_GPIO
		int "RESET GPIO number"
		range -1 GPIO_RANGE_MAX
		default 15 if IDF_TARGET_ESP32
		default 38 if IDF_TARGET_ESP32S2 || IDF_TARGET_ESP32S3
		default  4 # C3 and others
		help
			GPIO number (IOxx) to RESET.
			When it is -1, RESET isn't performed.
			Some GPIOs are used for other purposes (flash connections, etc.) and cannot be used to RESET.
			GPIOs 35-39 are input-only so cannot be used as outputs.

	choice I2C_PORT
		depends on I2C_INTERFACE
		prompt "I2C port that controls this bus"
		default I2C_PORT_0
		help
			Select I2C port that controls this bus.
		config I2C_PORT_0
			bool "I2C_PORT_0"
			help
				Use I2C_PORT_0.
		config I2C_PORT_1
			depends on IDF_TARGET_ARCH_XTENSA
			bool "I2C_PORT_1"
			help
				Use I2C_PORT_1.
	endchoice

	choice SPI_HOST
		depends on SPI_INTERFACE
		prompt "SPI peripheral that controls this bus"
		default SPI2_HOST
		help
			Select SPI peripheral that controls this bus.
		config SPI2_HOST
			bool "SPI2_HOST"
			help
				Use SPI2_HOST. This is also called HSPI_HOST.
		config SPI3_HOST
			depends on IDF_TARGET_ARCH_XTENSA
			bool "SPI3_HOST"
			help
				USE SPI3_HOST. This is also called VSPI_HOST
	endchoice
	
	endmenu

	menu "SmartSocket Mesh Configuration"

		choice
			bool "Mesh Topology"
			default MESH_TOPO_TREE
			help
				Mesh Network Topology.
	
			config MESH_TOPO_TREE
				bool "MESH_TOPO_TREE"
			config MESH_TOPO_CHAIN
				bool "MESH_TOPO_CHAIN"
		endchoice
	
		config MESH_TOPOLOGY
			int
			default 0 if MESH_TOPO_TREE
			default 1 if MESH_TOPO_CHAIN
			help
				Mesh Network Topology.
	
		config MESH_ENABLE_PS
			bool "Enable mesh PS (power save) function"
			default y
			help
				Enable/Disable Power Save function.
	
		choice
			bool "Mesh PS device duty cycle type"
			depends on MESH_ENABLE_PS
			default MESH_PS_DEV_DUTY_TYPE_REQUEST
			help
				Mesh PS device duty cycle type.
	
			config MESH_PS_DEV_DUTY_TYPE_REQUEST
				bool "MESH_PS_DEV_DUTY_TYPE_REQUEST"
			config MESH_PS_DEV_DUTY_TYPE_DEMAND
				bool "MESH_PS_DEV_DUTY_TYPE_DEMAND"
		endchoice
	
		config MESH_PS_DEV_DUTY_TYPE
			int
			depends on MESH_ENABLE_PS
			default 1 if MESH_PS_DEV_DUTY_TYPE_REQUEST
			default 4 if MESH_PS_DEV_DUTY_TYPE_DEMAND
			help
				Mesh PS device duty cycle type.
	
		config MESH_PS_DEV_DUTY
			int "Mesh PS device duty cycle"
			depends on MESH_ENABLE_PS
			range 1 100
			default 10
			help
				Mesh PS device duty cycle.
	
		config MESH_PS_NWK_DUTY
			int "Mesh PS network duty cycle"
			depends on MESH_ENABLE_PS
			range 1 100
			default 10
			help
				Mesh PS network duty cycle.
	
		config MESH_PS_NWK_DUTY_DURATION
			int "Mesh PS network duty cycle duration (unit: minutes)"
			depends on MESH_ENABLE_PS
			range -1 100
			default -1
			help
				Mesh PS network duty cycle duration.
	
		choice
			bool "Mesh PS network duty cycle rule"
			depends on MESH_ENABLE_PS
			default MESH_PS_NETWORK_DUTY_APPLIED_ENTIRE
			help
				Mesh PS network duty cycle rule.
	
			config MESH_PS_NETWORK_DUTY_APPLIED_ENTIRE
				bool "MESH_PS_NETWORK_DUTY_APPLIED_ENTIRE"
			config MESH_PS_NETWORK_DUTY_APPLIED_UPLINK
				bool "MESH_PS_NETWORK_DUTY_APPLIED_UPLINK"
		endchoice
	
		config MESH_PS_NWK_DUTY_RULE
			int
			depends on MESH_ENABLE_PS
			default 0 if MESH_PS_NETWORK_DUTY_APPLIED_ENTIRE
			default 1 if MESH_PS_NETWORK_DUTY_APPLIED_UPLINK
			help
				Mesh PS network duty cycle rule.
	
		config MESH_MAX_LAYER
			int "Mesh Max Layer"
			range 1 25 if MESH_TOPO_TREE
			range 1 1000 if MESH_TOPO_CHAIN
			default 6
			help
				Max layer allowed in mesh network.
	
		config MESH_CHANNEL
			int "channel"
			range 0 14
			default 0
			help
				mesh network channel.
	
		config MESH_ROUTER_SSID
			string "Router SSID"
			default "ROUTER_SSID"
			help
				Router SSID.
	
		config MESH_ROUTER_PASSWD
			string "Router password"
			default "ROUTER_PASSWD"
			help
				Router password.
	
		choice
			bool "Mesh AP Authentication Mode"
			default WIFI_AUTH_WPA2_PSK
			help
				Authentication mode.
	
			config WIFI_AUTH_OPEN
				bool "WIFI_AUTH_OPEN"
			config WIFI_AUTH_WPA_PSK
				bool "WIFI_AUTH_WPA_PSK"
			config WIFI_AUTH_WPA2_PSK
				bool "WIFI_AUTH_WPA2_PSK"
			config WIFI_AUTH_WPA_WPA2_PSK
				bool "WIFI_AUTH_WPA_WPA2_PSK"
		endchoice
	
		config MESH_AP_AUTHMODE
			int
			default 0 if WIFI_AUTH_OPEN
			default 2 if WIFI_AUTH_WPA_PSK
			default 3 if WIFI_AUTH_WPA2_PSK
			default 4 if WIFI_AUTH_WPA_WPA2_PSK
			help
				Mesh AP authentication mode.
	
		config MESH_AP_PASSWD
			string "Mesh AP Password"
			default "MAP_PASSWD"
			help
				Mesh AP password.
	
		config MESH_AP_CONNECTIONS
			int "Mesh AP Connections"
			range 1 10
			default 6
			help
				The number of mesh stations allowed to connect in.
	
		config MESH_NON_MESH_AP_CONNECTIONS
			int "Mesh Non Mesh AP Connections"
			range 0 9
			default 0
			help
				The number of non-mesh stations allowed to connect in.
	
		config MESH_ROUTE_TABLE_SIZE
			int "Mesh Routing Table Size"
			range 1 300
			default 50
			help
				The number of devices over the network(max: 300).
	endmenu
```

## UART_Test/main/Kconfig.projbuild
```kconfig
menu "SSD1306 Configuration and MWIFI configuration"

	config GPIO_RANGE_MAX
		int
		default 33 if IDF_TARGET_ESP32
		default 46 if IDF_TARGET_ESP32S2
		default 48 if IDF_TARGET_ESP32S3
		default 18 if IDF_TARGET_ESP32C2
		default 19 if IDF_TARGET_ESP32C3
		default 30 if IDF_TARGET_ESP32C6
		default 27 if IDF_TARGET_ESP32H2

	choice INTERFACE
		prompt "Interface"
		default I2C_INTERFACE
		help
			Select Interface.
		config I2C_INTERFACE
			bool "I2C Interface"
			help
				I2C Interface.
		config SPI_INTERFACE
			bool "SPI Interface"
			help
				SPI Interface.
	endchoice

	choice PANEL
		prompt "Panel Type"
		default SSD1306_128x64
		help
			Select Panel Type.
		config SSD1306_128x32
			bool "128x32 Panel"
			help
				Panel is 128x32.
		config SSD1306_128x64
			bool "128x64 Panel"
			help
				Panel is 128x64.
	endchoice

	config OFFSETX
		int "GRAM X OFFSET"
		range 0 99
		default 0
		help
			When your TFT have offset(X), set it.

	config FLIP
		bool "Flip upside down"
		default false
		help
			Flip upside down.

	config SCL_GPIO
		depends on I2C_INTERFACE
		int "SCL GPIO number"
		range 0 GPIO_RANGE_MAX
		default 22 if IDF_TARGET_ESP32
		default  2 if IDF_TARGET_ESP32S2 || IDF_TARGET_ESP32S3
		default  2 if IDF_TARGET_ESP32H2
		default  6 # C3 and others
		help
			GPIO number (IOxx) to I2C SCL.
			Some GPIOs are used for other purposes (flash connections, etc.) and cannot be used to I2C.
			GPIOs 35-39 are input-only so cannot be used as outputs.

	config SDA_GPIO
		depends on I2C_INTERFACE
		int "SDA GPIO number"
		range 0 GPIO_RANGE_MAX
		default 21 if IDF_TARGET_ESP32
		default  1 if IDF_TARGET_ESP32S2 || IDF_TARGET_ESP32S3
		default  1 if IDF_TARGET_ESP32H2
		default  5 # C3 and others
		help
			GPIO number (IOxx) to I2C SDA.
			Some GPIOs are used for other purposes (flash connections, etc.) and cannot be used to I2C.
			GPIOs 35-39 are input-only so cannot be used as outputs.

	config MOSI_GPIO
		depends on SPI_INTERFACE
		int "MOSI GPIO number"
		range 0 GPIO_RANGE_MAX
		default 23 if IDF_TARGET_ESP32
		default 35 if IDF_TARGET_ESP32S2 || IDF_TARGET_ESP32S3
		default  1 # C3 and others
		help
			GPIO number (IOxx) to SPI MOSI.
			Some GPIOs are used for other purposes (flash connections, etc.) and cannot be used to MOSI.
			On the ESP32, GPIOs 35-39 are input-only so cannot be used as outputs.
			On the ESP32-S2, GPIO 46 is input-only so cannot be used as outputs.

	config SCLK_GPIO
		depends on SPI_INTERFACE
		int "SCLK GPIO number"
		range 0 GPIO_RANGE_MAX
		default 18 if IDF_TARGET_ESP32
		default 36 if IDF_TARGET_ESP32S2 || IDF_TARGET_ESP32S3
		default  2 # C3 and others
		help
			GPIO number (IOxx) to SPI SCLK.
			Some GPIOs are used for other purposes (flash connections, etc.) and cannot be used to SCLK.
			On the ESP32, GPIOs 35-39 are input-only so cannot be used as outputs.
			On the ESP32-S2, GPIO 46 is input-only so cannot be used as outputs.

	config CS_GPIO
		depends on SPI_INTERFACE
		int "CS GPIO number"
		range 0 GPIO_RANGE_MAX
		default  5 if IDF_TARGET_ESP32
		default 34 if IDF_TARGET_ESP32S2 || IDF_TARGET_ESP32S3
		default 10 # C3 and others
		help
			GPIO number (IOxx) to SPI CS.
			Some GPIOs are used for other purposes (flash connections, etc.) and cannot be used to CS.
			GPIOs 35-39 are input-only so cannot be used as outputs.

	config DC_GPIO
		depends on SPI_INTERFACE
		int "DC GPIO number"
		range 0 GPIO_RANGE_MAX
		default  4 if IDF_TARGET_ESP32
		default 37 if IDF_TARGET_ESP32S2 || IDF_TARGET_ESP32S3
		default  3 # C3 and others
		help
			GPIO number (IOxx) to SPI DC.
			Some GPIOs are used for other purposes (flash connections, etc.) and cannot be used to DC.
			GPIOs 35-39 are input-only so cannot be used as outputs.

	config RESET_GPIO
		int "RESET GPIO number"
		range -1 GPIO_RANGE_MAX
		default 15 if IDF_TARGET_ESP32
		default 38 if IDF_TARGET_ESP32S2 || IDF_TARGET_ESP32S3
		default  4 # C3 and others
		help
			GPIO number (IOxx) to RESET.
			When it is -1, RESET isn't performed.
			Some GPIOs are used for other purposes (flash connections, etc.) and cannot be used to RESET.
			GPIOs 35-39 are input-only so cannot be used as outputs.

	choice I2C_PORT
		depends on I2C_INTERFACE
		prompt "I2C port that controls this bus"
		default I2C_PORT_0
		help
			Select I2C port that controls this bus.
		config I2C_PORT_0
			bool "I2C_PORT_0"
			help
				Use I2C_PORT_0.
		config I2C_PORT_1
			depends on IDF_TARGET_ARCH_XTENSA
			bool "I2C_PORT_1"
			help
				Use I2C_PORT_1.
	endchoice

	choice SPI_HOST
		depends on SPI_INTERFACE
		prompt "SPI peripheral that controls this bus"
		default SPI2_HOST
		help
			Select SPI peripheral that controls this bus.
		config SPI2_HOST
			bool "SPI2_HOST"
			help
				Use SPI2_HOST. This is also called HSPI_HOST.
		config SPI3_HOST
			depends on IDF_TARGET_ARCH_XTENSA
			bool "SPI3_HOST"
			help
				USE SPI3_HOST. This is also called VSPI_HOST
	endchoice

	choice DEVICE_TYPE
		bool "Configure the device type"
		default DEVICE_TYPE_NODE
		help
			Configure the device type
	
	config DEVICE_TYPE_IDLE
	   bool "IDLE device"
	config DEVICE_TYPE_ROOT
	   bool "Root device"
	config DEVICE_TYPE_NODE
	   bool "Non-Root device"
	config DEVICE_TYPE_LEAF
	   bool "Leaf device"
	endchoice
	
	config DEVICE_TYPE
		int
		default 0 if DEVICE_TYPE_IDLE
		default 1 if DEVICE_TYPE_ROOT
		default 2 if DEVICE_TYPE_NODE
		default 3 if DEVICE_TYPE_LEAF
	
	config MESH_ID
		string "Mesh ID"
			default "123456"
			help
				The maximum length is 6 bytes. Mesh network identification,
				Nodes with the same mesh ID can, communicate with each other.
	
	config MESH_CHANNEL
		int "Mesh network channel"
		range 1 14
		default 13
		help
			Mesh network channel.
	
	endmenu
```
